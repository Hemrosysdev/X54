## EspApp/Application/Main/Kconfig
```kconfig
menu "X54 application configuration"

    config DEBUG_WEB_SOCKET
        bool "Debug WebSocket communication"
        default n

    config DEBUG_JSON_COMMUNICATION
        bool "Debug JSON communication"
        default n

    config DEBUG_OTA_TIMING
        bool "Debug OTA timing"
        default n

endmenu
```

## EspApp/sdkconfig.defaults
```kconfig
CONFIG_IDF_TARGET="esp32"
CONFIG_IDF_TARGET_ESP32=y

CONFIG_ESPTOOLPY_FLASHSIZE_8MB=y
CONFIG_ESPTOOLPY_BAUD_2MB=y
CONFIG_ESPTOOLPY_BAUD=2000000

CONFIG_COMPILER_CXX_RTTI=y
CONFIG_COMPILER_CXX_EXCEPTIONS=y
CONFIG_COMPILER_OPTIMIZATION_SIZE=y
CONFIG_COMPILER_OPTIMIZATION_LEVEL_RELEASE=y

CONFIG_PARTITION_TABLE_CUSTOM=y

CONFIG_HTTPD_MAX_REQ_HDR_LEN=5000
CONFIG_HTTPD_MAX_URI_LEN=1024
```
